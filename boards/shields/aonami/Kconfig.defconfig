## boards/shields/aonami/Kconfig.defconfig
```kconfig
# Copyright (c) 2022 The ZMK Contributors
# SPDX-License-Identifier: MIT

if SHIELD_AONAMI_LEFT

config ZMK_KEYBOARD_NAME
    default "AONAMI"
    
config ZMK_SPLIT_ROLE_CENTRAL
    default y

endif

if SHIELD_AONAMI_LEFT || SHIELD_AONAMI_RIGHT

config ZMK_SPLIT
    default y

endif
```

## boards/shields/aonami/Kconfig.shield
```kconfig
# Copyright (c) 2022 The ZMK Contributors
# SPDX-License-Identifier: MIT

config SHIELD_AONAMI_LEFT
    def_bool $(shields_list_contains,aonami_left)

config SHIELD_AONAMI_RIGHT
    def_bool $(shields_list_contains,aonami_right)
```
